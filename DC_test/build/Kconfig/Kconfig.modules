## DC_test/build/Kconfig/Kconfig.modules
```kconfig
ZEPHYR_ACPICA_MODULE_DIR := /home/quantumvortex/zephyrproject/modules/lib/acpica
menu "acpica (/home/quantumvortex/zephyrproject/modules/lib/acpica)"
osource "$(ZEPHYR_ACPICA_KCONFIG)"
config ZEPHYR_ACPICA_MODULE
	bool
	default y
endmenu
ZEPHYR_CMSIS_MODULE_DIR := /home/quantumvortex/zephyrproject/modules/hal/cmsis
menu "cmsis (/home/quantumvortex/zephyrproject/modules/hal/cmsis)"
osource "$(ZEPHYR_CMSIS_KCONFIG)"
config ZEPHYR_CMSIS_MODULE
	bool
	default y
endmenu
ZEPHYR_CMSIS_DSP_MODULE_DIR := /home/quantumvortex/zephyrproject/modules/lib/cmsis-dsp
menu "cmsis-dsp (/home/quantumvortex/zephyrproject/modules/lib/cmsis-dsp)"
osource "$(ZEPHYR_CMSIS_DSP_KCONFIG)"
config ZEPHYR_CMSIS_DSP_MODULE
	bool
	default y
endmenu
ZEPHYR_CMSIS_NN_MODULE_DIR := /home/quantumvortex/zephyrproject/modules/lib/cmsis-nn
menu "cmsis-nn (/home/quantumvortex/zephyrproject/modules/lib/cmsis-nn)"
osource "$(ZEPHYR_CMSIS_NN_KCONFIG)"
config ZEPHYR_CMSIS_NN_MODULE
	bool
	default y
endmenu
ZEPHYR_CMSIS_6_MODULE_DIR := /home/quantumvortex/zephyrproject/modules/hal/cmsis_6
menu "cmsis_6 (/home/quantumvortex/zephyrproject/modules/hal/cmsis_6)"
osource "$(ZEPHYR_CMSIS_6_KCONFIG)"
config ZEPHYR_CMSIS_6_MODULE
	bool
	default y
endmenu
ZEPHYR_FATFS_MODULE_DIR := /home/quantumvortex/zephyrproject/modules/fs/fatfs
menu "fatfs (/home/quantumvortex/zephyrproject/modules/fs/fatfs)"
osource "$(ZEPHYR_FATFS_KCONFIG)"
config ZEPHYR_FATFS_MODULE
	bool
	default y
endmenu
ZEPHYR_ADI_MODULE_DIR := /home/quantumvortex/zephyrproject/modules/hal/adi
config ZEPHYR_ADI_MODULE
	bool
	default y
ZEPHYR_HAL_AFBR_MODULE_DIR := /home/quantumvortex/zephyrproject/modules/hal/afbr
menu "hal_afbr (/home/quantumvortex/zephyrproject/modules/hal/afbr)"
osource "$(ZEPHYR_HAL_AFBR_KCONFIG)"
config ZEPHYR_HAL_AFBR_MODULE
	bool
	default y

config ZEPHYR_HAL_AFBR_MODULE_BLOBS
	bool
endmenu
ZEPHYR_HAL_AMBIQ_MODULE_DIR := /home/quantumvortex/zephyrproject/modules/hal/ambiq
menu "hal_ambiq (/home/quantumvortex/zephyrproject/modules/hal/ambiq)"
osource "$(ZEPHYR_HAL_AMBIQ_KCONFIG)"
config ZEPHYR_HAL_AMBIQ_MODULE
	bool
	default y
endmenu
ZEPHYR_ATMEL_MODULE_DIR := /home/quantumvortex/zephyrproject/modules/hal/atmel
config ZEPHYR_ATMEL_MODULE
	bool
	default y
ZEPHYR_HAL_BOUFFALOLAB_MODULE_DIR := /home/quantumvortex/zephyrproject/modules/hal/bouffalolab
menu "hal_bouffalolab (/home/quantumvortex/zephyrproject/modules/hal/bouffalolab)"
osource "$(ZEPHYR_HAL_BOUFFALOLAB_KCONFIG)"
config ZEPHYR_HAL_BOUFFALOLAB_MODULE
	bool
	default y
endmenu
ZEPHYR_HAL_ESPRESSIF_MODULE_DIR := /home/quantumvortex/zephyrproject/modules/hal/espressif
menu "hal_espressif (/home/quantumvortex/zephyrproject/modules/hal/espressif)"
osource "/home/quantumvortex/zephyrproject/modules/hal/espressif/zephyr/Kconfig"
config ZEPHYR_HAL_ESPRESSIF_MODULE
	bool
	default y

config ZEPHYR_HAL_ESPRESSIF_MODULE_BLOBS
	bool
endmenu
ZEPHYR_HAL_ETHOS_U_MODULE_DIR := /home/quantumvortex/zephyrproject/modules/hal/ethos_u
menu "hal_ethos_u (/home/quantumvortex/zephyrproject/modules/hal/ethos_u)"
osource "$(ZEPHYR_HAL_ETHOS_U_KCONFIG)"
config ZEPHYR_HAL_ETHOS_U_MODULE
	bool
	default y
endmenu
ZEPHYR_HAL_GIGADEVICE_MODULE_DIR := /home/quantumvortex/zephyrproject/modules/hal/gigadevice
menu "hal_gigadevice (/home/quantumvortex/zephyrproject/modules/hal/gigadevice)"
osource "$(ZEPHYR_HAL_GIGADEVICE_KCONFIG)"
config ZEPHYR_HAL_GIGADEVICE_MODULE
	bool
	default y
endmenu
ZEPHYR_HAL_INFINEON_MODULE_DIR := /home/quantumvortex/zephyrproject/modules/hal/infineon
menu "hal_infineon (/home/quantumvortex/zephyrproject/modules/hal/infineon)"
osource "$(ZEPHYR_HAL_INFINEON_KCONFIG)"
config ZEPHYR_HAL_INFINEON_MODULE
	bool
	default y

config ZEPHYR_HAL_INFINEON_MODULE_BLOBS
	bool
endmenu
ZEPHYR_HAL_INTEL_MODULE_DIR := /home/quantumvortex/zephyrproject/modules/hal/intel
menu "hal_intel (/home/quantumvortex/zephyrproject/modules/hal/intel)"
osource "/home/quantumvortex/zephyrproject/modules/hal/intel/zephyr/Kconfig"
config ZEPHYR_HAL_INTEL_MODULE
	bool
	default y
endmenu
ZEPHYR_MICROCHIP_MODULE_DIR := /home/quantumvortex/zephyrproject/modules/hal/microchip
config ZEPHYR_MICROCHIP_MODULE
	bool
	default y
ZEPHYR_HAL_NORDIC_MODULE_DIR := /home/quantumvortex/zephyrproject/modules/hal/nordic
menu "hal_nordic (/home/quantumvortex/zephyrproject/modules/hal/nordic)"
osource "$(ZEPHYR_HAL_NORDIC_KCONFIG)"
config ZEPHYR_HAL_NORDIC_MODULE
	bool
	default y

config ZEPHYR_HAL_NORDIC_MODULE_BLOBS
	bool
endmenu
ZEPHYR_NUVOTON_MODULE_DIR := /home/quantumvortex/zephyrproject/modules/hal/nuvoton
config ZEPHYR_NUVOTON_MODULE
	bool
	default y
ZEPHYR_HAL_NXP_MODULE_DIR := /home/quantumvortex/zephyrproject/modules/hal/nxp
menu "hal_nxp (/home/quantumvortex/zephyrproject/modules/hal/nxp)"
osource "$(ZEPHYR_HAL_NXP_KCONFIG)"
config ZEPHYR_HAL_NXP_MODULE
	bool
	default y

config ZEPHYR_HAL_NXP_MODULE_BLOBS
	bool
endmenu
ZEPHYR_OPENISA_MODULE_DIR := /home/quantumvortex/zephyrproject/modules/hal/openisa
config ZEPHYR_OPENISA_MODULE
	bool
	default y
ZEPHYR_QUICKLOGIC_MODULE_DIR := /home/quantumvortex/zephyrproject/modules/hal/quicklogic
config ZEPHYR_QUICKLOGIC_MODULE
	bool
	default y
ZEPHYR_HAL_RENESAS_MODULE_DIR := /home/quantumvortex/zephyrproject/modules/hal/renesas
config ZEPHYR_HAL_RENESAS_MODULE
	bool
	default y

config ZEPHYR_HAL_RENESAS_MODULE_BLOBS
	bool
ZEPHYR_HAL_RPI_PICO_MODULE_DIR := /home/quantumvortex/zephyrproject/modules/hal/rpi_pico
menu "hal_rpi_pico (/home/quantumvortex/zephyrproject/modules/hal/rpi_pico)"
osource "$(ZEPHYR_HAL_RPI_PICO_KCONFIG)"
config ZEPHYR_HAL_RPI_PICO_MODULE
	bool
	default y
endmenu
ZEPHYR_HAL_SILABS_MODULE_DIR := /home/quantumvortex/zephyrproject/modules/hal/silabs
menu "hal_silabs (/home/quantumvortex/zephyrproject/modules/hal/silabs)"
osource "$(ZEPHYR_HAL_SILABS_KCONFIG)"
config ZEPHYR_HAL_SILABS_MODULE
	bool
	default y

config ZEPHYR_HAL_SILABS_MODULE_BLOBS
	bool
endmenu
ZEPHYR_HAL_ST_MODULE_DIR := /home/quantumvortex/zephyrproject/modules/hal/st
menu "hal_st (/home/quantumvortex/zephyrproject/modules/hal/st)"
osource "$(ZEPHYR_HAL_ST_KCONFIG)"
config ZEPHYR_HAL_ST_MODULE
	bool
	default y
endmenu
ZEPHYR_HAL_STM32_MODULE_DIR := /home/quantumvortex/zephyrproject/modules/hal/stm32
config ZEPHYR_HAL_STM32_MODULE
	bool
	default y

config ZEPHYR_HAL_STM32_MODULE_BLOBS
	bool
ZEPHYR_HAL_TDK_MODULE_DIR := /home/quantumvortex/zephyrproject/modules/hal/tdk
menu "hal_tdk (/home/quantumvortex/zephyrproject/modules/hal/tdk)"
osource "$(ZEPHYR_HAL_TDK_KCONFIG)"
config ZEPHYR_HAL_TDK_MODULE
	bool
	default y
endmenu
ZEPHYR_HAL_TELINK_MODULE_DIR := /home/quantumvortex/zephyrproject/modules/hal/telink
menu "hal_telink (/home/quantumvortex/zephyrproject/modules/hal/telink)"
osource "/home/quantumvortex/zephyrproject/modules/hal/telink/Kconfig"
config ZEPHYR_HAL_TELINK_MODULE
	bool
	default y
endmenu
ZEPHYR_TI_MODULE_DIR := /home/quantumvortex/zephyrproject/modules/hal/ti
config ZEPHYR_TI_MODULE
	bool
	default y
ZEPHYR_HAL_WCH_MODULE_DIR := /home/quantumvortex/zephyrproject/modules/hal/wch
menu "hal_wch (/home/quantumvortex/zephyrproject/modules/hal/wch)"
osource "$(ZEPHYR_HAL_WCH_KCONFIG)"
config ZEPHYR_HAL_WCH_MODULE
	bool
	default y
endmenu
ZEPHYR_HAL_WURTHELEKTRONIK_MODULE_DIR := /home/quantumvortex/zephyrproject/modules/hal/wurthelektronik
config ZEPHYR_HAL_WURTHELEKTRONIK_MODULE
	bool
	default y
ZEPHYR_XTENSA_MODULE_DIR := /home/quantumvortex/zephyrproject/modules/hal/xtensa
config ZEPHYR_XTENSA_MODULE
	bool
	default y
ZEPHYR_HOSTAP_MODULE_DIR := /home/quantumvortex/zephyrproject/modules/lib/hostap
menu "hostap (/home/quantumvortex/zephyrproject/modules/lib/hostap)"
osource "$(ZEPHYR_HOSTAP_KCONFIG)"
config ZEPHYR_HOSTAP_MODULE
	bool
	default y
endmenu
ZEPHYR_LIBLC3_MODULE_DIR := /home/quantumvortex/zephyrproject/modules/lib/liblc3
menu "liblc3 (/home/quantumvortex/zephyrproject/modules/lib/liblc3)"
osource "$(ZEPHYR_LIBLC3_KCONFIG)"
config ZEPHYR_LIBLC3_MODULE
	bool
	default y
endmenu
ZEPHYR_LIBMCTP_MODULE_DIR := /home/quantumvortex/zephyrproject/modules/lib/libmctp
config ZEPHYR_LIBMCTP_MODULE
	bool
	default y
ZEPHYR_LIBMETAL_MODULE_DIR := /home/quantumvortex/zephyrproject/modules/hal/libmetal
config ZEPHYR_LIBMETAL_MODULE
	bool
	default y
ZEPHYR_LIBSBC_MODULE_DIR := /home/quantumvortex/zephyrproject/modules/lib/libsbc
menu "libsbc (/home/quantumvortex/zephyrproject/modules/lib/libsbc)"
osource "$(ZEPHYR_LIBSBC_KCONFIG)"
config ZEPHYR_LIBSBC_MODULE
	bool
	default y
endmenu
ZEPHYR_LITTLEFS_MODULE_DIR := /home/quantumvortex/zephyrproject/modules/fs/littlefs
menu "littlefs (/home/quantumvortex/zephyrproject/modules/fs/littlefs)"
osource "$(ZEPHYR_LITTLEFS_KCONFIG)"
config ZEPHYR_LITTLEFS_MODULE
	bool
	default y
endmenu
ZEPHYR_LORAMAC_NODE_MODULE_DIR := /home/quantumvortex/zephyrproject/modules/lib/loramac-node
menu "loramac-node (/home/quantumvortex/zephyrproject/modules/lib/loramac-node)"
osource "$(ZEPHYR_LORAMAC_NODE_KCONFIG)"
config ZEPHYR_LORAMAC_NODE_MODULE
	bool
	default y
endmenu
ZEPHYR_LVGL_MODULE_DIR := /home/quantumvortex/zephyrproject/modules/lib/gui/lvgl
menu "lvgl (/home/quantumvortex/zephyrproject/modules/lib/gui/lvgl)"
osource "/home/quantumvortex/zephyrproject/modules/lib/gui/lvgl/zephyr/Kconfig"
config ZEPHYR_LVGL_MODULE
	bool
	default y
endmenu
ZEPHYR_MBEDTLS_MODULE_DIR := /home/quantumvortex/zephyrproject/modules/crypto/mbedtls
menu "mbedtls (/home/quantumvortex/zephyrproject/modules/crypto/mbedtls)"
osource "$(ZEPHYR_MBEDTLS_KCONFIG)"
config ZEPHYR_MBEDTLS_MODULE
	bool
	default y
endmenu
ZEPHYR_MCUBOOT_MODULE_DIR := /home/quantumvortex/zephyrproject/bootloader/mcuboot
config ZEPHYR_MCUBOOT_MODULE
	bool
	default y
ZEPHYR_MIPI_SYS_T_MODULE_DIR := /home/quantumvortex/zephyrproject/modules/debug/mipi-sys-t
config ZEPHYR_MIPI_SYS_T_MODULE
	bool
	default y
ZEPHYR_NANOPB_MODULE_DIR := /home/quantumvortex/zephyrproject/modules/lib/nanopb
menu "nanopb (/home/quantumvortex/zephyrproject/modules/lib/nanopb)"
osource "$(ZEPHYR_NANOPB_KCONFIG)"
config ZEPHYR_NANOPB_MODULE
	bool
	default y
endmenu
ZEPHYR_NRF_WIFI_MODULE_DIR := /home/quantumvortex/zephyrproject/modules/lib/nrf_wifi
menu "nrf_wifi (/home/quantumvortex/zephyrproject/modules/lib/nrf_wifi)"
osource "$(ZEPHYR_NRF_WIFI_KCONFIG)"
config ZEPHYR_NRF_WIFI_MODULE
	bool
	default y

config ZEPHYR_NRF_WIFI_MODULE_BLOBS
	bool
endmenu
ZEPHYR_OPEN_AMP_MODULE_DIR := /home/quantumvortex/zephyrproject/modules/lib/open-amp
config ZEPHYR_OPEN_AMP_MODULE
	bool
	default y
ZEPHYR_OPENTHREAD_MODULE_DIR := /home/quantumvortex/zephyrproject/modules/lib/openthread
menu "openthread (/home/quantumvortex/zephyrproject/modules/lib/openthread)"
osource "$(ZEPHYR_OPENTHREAD_KCONFIG)"
config ZEPHYR_OPENTHREAD_MODULE
	bool
	default y
endmenu
ZEPHYR_PERCEPIO_MODULE_DIR := /home/quantumvortex/zephyrproject/modules/debug/percepio
menu "percepio (/home/quantumvortex/zephyrproject/modules/debug/percepio)"
osource "/home/quantumvortex/zephyrproject/modules/debug/percepio/zephyr/Kconfig"
config ZEPHYR_PERCEPIO_MODULE
	bool
	default y
endmenu
ZEPHYR_PICOLIBC_MODULE_DIR := /home/quantumvortex/zephyrproject/modules/lib/picolibc
menu "picolibc (/home/quantumvortex/zephyrproject/modules/lib/picolibc)"
osource "/home/quantumvortex/zephyrproject/modules/lib/picolibc/zephyr/Kconfig"
config ZEPHYR_PICOLIBC_MODULE
	bool
	default y
endmenu
ZEPHYR_SEGGER_MODULE_DIR := /home/quantumvortex/zephyrproject/modules/debug/segger
menu "segger (/home/quantumvortex/zephyrproject/modules/debug/segger)"
osource "$(ZEPHYR_SEGGER_KCONFIG)"
config ZEPHYR_SEGGER_MODULE
	bool
	default y
endmenu
ZEPHYR_TRUSTED_FIRMWARE_A_MODULE_DIR := /home/quantumvortex/zephyrproject/modules/tee/tf-a/trusted-firmware-a
menu "trusted-firmware-a (/home/quantumvortex/zephyrproject/modules/tee/tf-a/trusted-firmware-a)"
osource "$(ZEPHYR_TRUSTED_FIRMWARE_A_KCONFIG)"
config ZEPHYR_TRUSTED_FIRMWARE_A_MODULE
	bool
	default y
endmenu
ZEPHYR_TRUSTED_FIRMWARE_M_MODULE_DIR := /home/quantumvortex/zephyrproject/modules/tee/tf-m/trusted-firmware-m
menu "trusted-firmware-m (/home/quantumvortex/zephyrproject/modules/tee/tf-m/trusted-firmware-m)"
osource "$(ZEPHYR_TRUSTED_FIRMWARE_M_KCONFIG)"
config ZEPHYR_TRUSTED_FIRMWARE_M_MODULE
	bool
	default y
endmenu
ZEPHYR_UOSCORE_UEDHOC_MODULE_DIR := /home/quantumvortex/zephyrproject/modules/lib/uoscore-uedhoc
menu "uoscore-uedhoc (/home/quantumvortex/zephyrproject/modules/lib/uoscore-uedhoc)"
osource "$(ZEPHYR_UOSCORE_UEDHOC_KCONFIG)"
config ZEPHYR_UOSCORE_UEDHOC_MODULE
	bool
	default y
endmenu
ZEPHYR_ZCBOR_MODULE_DIR := /home/quantumvortex/zephyrproject/modules/lib/zcbor
menu "zcbor (/home/quantumvortex/zephyrproject/modules/lib/zcbor)"
osource "$(ZEPHYR_ZCBOR_KCONFIG)"
config ZEPHYR_ZCBOR_MODULE
	bool
	default y
endmenu
ZEPHYR_NRF_HW_MODELS_MODULE_DIR := /home/quantumvortex/zephyrproject/modules/bsim_hw_models/nrf_hw_models
config ZEPHYR_NRF_HW_MODELS_MODULE
	bool
	default y
```

## DC_test/build/Kconfig/arch/Kconfig
```kconfig
# Load Zephyr Arch Kconfig descriptions.
osource "/home/quantumvortex/zephyrproject/zephyr/arch/rx/Kconfig"
osource "/home/quantumvortex/zephyrproject/zephyr/arch/x86/Kconfig"
osource "/home/quantumvortex/zephyrproject/zephyr/arch/xtensa/Kconfig"
osource "/home/quantumvortex/zephyrproject/zephyr/arch/sparc/Kconfig"
osource "/home/quantumvortex/zephyrproject/zephyr/arch/riscv/Kconfig"
osource "/home/quantumvortex/zephyrproject/zephyr/arch/posix/Kconfig"
osource "/home/quantumvortex/zephyrproject/zephyr/arch/mips/Kconfig"
osource "/home/quantumvortex/zephyrproject/zephyr/arch/arm64/Kconfig"
osource "/home/quantumvortex/zephyrproject/zephyr/arch/arm/Kconfig"
osource "/home/quantumvortex/zephyrproject/zephyr/arch/arc/Kconfig"
```

## DC_test/build/Kconfig/boards/Kconfig.nucleo_h7a3zi_q
```kconfig
# Load board Kconfig descriptions.
osource "/home/quantumvortex/zephyrproject/zephyr/boards/st/nucleo_h7a3zi_q/Kconfig.nucleo_h7a3zi_q"
```

## DC_test/build/Kconfig/boards/Kconfig.sysbuild
```kconfig
# Load Sysbuild board Kconfig descriptions.
osource "/home/quantumvortex/zephyrproject/zephyr/boards/st/nucleo_h7a3zi_q/Kconfig.sysbuild"
```
